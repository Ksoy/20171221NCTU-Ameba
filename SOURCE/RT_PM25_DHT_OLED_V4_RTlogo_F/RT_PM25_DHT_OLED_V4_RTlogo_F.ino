/*
 This example demonstrate how to read pm2.5 value on PMS 3003 air condition sensor

 PMS 3003 pin map is as follow:
    PIN1  :VCC, connect to 5V
    PIN2  :GND
    PIN3  :SET, 0:Standby mode, 1:operating mode
    PIN4  :RXD :Serial RX
    PIN5  :TXD :Serial TX
    PIN6  :RESET
    PIN7  :NC
    PIN8  :NC

 In this example, we only use Serial to get PM 2.5 value.

 The circuit:
 * RX is digital pin 0 (connect to TX of PMS 3003)
 * TX is digital pin 1 (connect to RX of PMS 3003)

 */

#include <Wire.h>
#include <SeeedOLED.h>
#include <SoftwareSerial.h>
#include <avr/pgmspace.h>
#include "DHT.h"  
#define DHTPIN 2
//#define DHTTYPE DHT22   // DHT 22  (AM2302)
#define DHTTYPE DHT11   // DHT 11  

static unsigned char realtek_ch[] PROGMEM ={
0x00, 0x00, 0x1F, 0x1E, 0xF0, 0xF0, 0xFC, 0x1F, 0x00, 0x00, 0x00, 0x00, 0x00, 0x00, 0x00, 0x00,
0x00, 0x00, 0x00, 0x00, 0x00, 0x00, 0x00, 0x00, 0x1F, 0xFC, 0xF0, 0xF8, 0x1E, 0x1F, 0x00, 0x00,
0x00, 0x00, 0x00, 0x00, 0x00, 0x00, 0x00, 0x00, 0x00, 0xE0, 0xE0, 0xE0, 0xE0, 0x20, 0x20, 0x20,
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0x00, 0x00, 0x00, 0x00, 0x00, 0x00, 0x00, 0x00, 0x00, 0x00, 0x00, 0x00, 0x00, 0x00, 0x00, 0x00
};

static unsigned char  Realtek_LogoR[] PROGMEM ={
0x00, 0x00, 0x3F, 0x3F, 0xFF, 0xFC, 0xFC, 0xFF, 0x3F, 0x3F, 0x00, 0x00, 0x00, 0x80, 0x80, 0x80,
0x00, 0x00, 0x00, 0x80, 0x80, 0x00, 0x00, 0x00, 0x3F, 0x3F, 0xFF, 0xFC, 0xF8, 0xFF, 0x3F, 0x3F,
0x00, 0x00, 0x00, 0x00, 0x00, 0x00, 0x00, 0x00, 0x00, 0x00, 0xE0, 0xE0, 0xE0, 0xE0, 0xE0, 0x60,
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0x00, 0x00, 0x00, 0x00, 0x00, 0x00, 0x00, 0x00, 0x00, 0x00, 0x00, 0x00, 0x00, 0x00, 0x00, 0x00
};

SoftwareSerial Serial1(0, 1); // RX, TX
#define pmsDataLen 32
uint8_t buf[pmsDataLen];
int idx = 0;
int pm10 = 0;
int pm25 = 0;
int pm100 = 0;
//float h,t,f;
boolean ThreadComplete;
static unsigned char logRT[1024];
DHT dht(DHTPIN, DHTTYPE);  // for standard DHT library

void setup() {
  Serial.begin(9600);
  Serial1.begin(9600); // PMS 3003 UART has baud rate 9600
  Wire.begin();	

  SeeedOled.init();  //initialze SEEED OLED display
  SeeedOled.clearDisplay();           //clear the screen and set start position to top left corner
  SeeedOled.drawBitmap( realtek_ch,1024); 
   delay (3000);
  
   memset(logRT, 0, 1024);
   memcpy(logRT,realtek_ch,384);
  // memset(realtek_ch, 0, 1024);
 //  SeeedOled.drawBitmap( realtek_ch,1024);  
  // SeeedOled.drawBitmap( logRT,384); 
  // SeeedOled.setNormalDisplay();       //Set display to Normal mode
   SeeedOled.setPageMode();            //Set addressing mode to Page Mode
   SeeedOled.setHorizontalScrollProperties(Scroll_Left,0,7,Scroll_5Frames); //Set Scrolling properties to Scroll Right
   SeeedOled.activateScroll();             // Activate Scrolling  
   dht.begin();
   delay (7000);
}

int numloop=0;

void loop() { // run over and over
  //delay(1000);
  uint8_t c = 0;
  idx = 0;
  int pv1,pv2,multiple;
  memset(buf, 0, pmsDataLen);

    numloop +=1;
  if (numloop == 1 ){
     SeeedOled.clearDisplay(); 
  //   SeeedOled.drawBitmap( realtek_ch,1024);
     SeeedOled.drawBitmap( logRT,384); 
     SeeedOled.setHorizontalScrollProperties(Scroll_Left,0,2,Scroll_5Frames); //Set Scrolling properties to Scroll Right
     SeeedOled.activateScroll();             // Activate Scrolling 
  }
  if (numloop >5 ){
   numloop =0;
  }
   Serial1.begin(9600);
  while (true) {
    while (c != 0x42) {
      while (!Serial1.available());
      c = Serial1.read();
    }
    while (!Serial1.available());
    c = Serial1.read();
    if (c == 0x4d) {
      // now we got a correct header)
      buf[idx++] = 0x42;
      buf[idx++] = 0x4d;
      break;
    }
  }

  while (idx != pmsDataLen) {
    while(!Serial1.available());
    buf[idx++] = Serial1.read();
    //delay(20);
  }

  pm10 = ( buf[10] << 8 ) | buf[11];
  pm25 = ( buf[12] << 8 ) | buf[13];
  pm100 = ( buf[14] << 8 ) | buf[15];
  Serial1.end();
  delay(2000);
  dht.begin(); 
  delay(2000);
  // Reading temperature or humidity takes about 250 milliseconds!
  // Sensor readings may also be up to 2 seconds 'old' (its a very slow sensor)
     float h = dht.readHumidity();
  // Read temperature as Celsius (the default)
  float t = dht.readTemperature();
  // Read temperature as Fahrenheit (isFahrenheit = true)
  float f = dht.readTemperature(true);

  // Check if any reads failed and exit early (to try again).
  if (isnan(h) || isnan(t) || isnan(f)) {
    Serial.println("Failed to read from DHT sensor!");
    //return;
  }
//dht.end();

  Serial.print("Humidity: ");
  Serial.print(h);
  Serial.print(" %\t");
  Serial.print("Temperature: ");
  Serial.print(t);
  Serial.println(" *C ");


  Serial.print("pm2.5: ");
  Serial.print(pm25);
  Serial.println(" ug/m3");
   Serial.print("pm1.0: ");
  Serial.print(pm10);
  Serial.println(" ug/m3");
   Serial.print("pm10: ");
  Serial.print(pm100);
  Serial.println(" ug/m3");
   multiple =101; 

   SeeedOled.setTextXY(4,0);
   pv1= (int) (t);
   pv2 = abs((int) (t *multiple) - (pv1*multiple)); 
   SeeedOled.putString("Temp:");
   SeeedOled.putNumber(pv1);        //Print number
   SeeedOled.putString("."); //Print the String
   SeeedOled.putNumber(pv2);        //Print number
   SeeedOled.putString("C  "); 
   
   SeeedOled.setTextXY(5,0);
   pv1= (int) (h);
   pv2 =abs((int) (h *multiple) - (pv1*multiple)); 
   SeeedOled.putString("Humi:");
   SeeedOled.putNumber(pv1);        //Print number
   SeeedOled.putString("."); //Print the String
   SeeedOled.putNumber(pv2);        //Print number
   SeeedOled.putString("%  ");  
 //  SeeedOled.clearDisplay();  
   SeeedOled.setTextXY(6,0); 
   SeeedOled.putString("pm2.5:") ;
   SeeedOled.putNumber(pm25);
   SeeedOled.putString("   ") ;
   SeeedOled.setTextXY(7,0); 
   SeeedOled.putString("pm1:"); 
   SeeedOled.putNumber(pm10);
   // SeeedOled.setTextXY(7,0); 
   SeeedOled.putString(",pm10:") ;
   SeeedOled.putNumber(pm100);
   SeeedOled.putString("  ") ;
   delay(5000);
  
}
