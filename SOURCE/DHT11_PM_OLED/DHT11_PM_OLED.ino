#include <Wire.h>
#include <SeeedOLED.h>
#include <SoftwareSerial.h>
#include <avr/pgmspace.h>
#include "DHT.h"  

#define DATA_LEN 32

uint8_t  int_pms5003[2];
uint8_t buf[DATA_LEN];
static unsigned char logRT[1024];

int DHT_PIN = 2;
DHT dht(DHT_PIN, DHT11);  // for standard DHT library
//DHT dht(DHT_PIN, DHT22);  // for standard DHT library

char c;
SoftwareSerial Serial1(0, 1); // RX, TX

static unsigned char realtek_ch[] PROGMEM ={
0x00, 0x00, 0x1F, 0x1E, 0xF0, 0xF0, 0xFC, 0x1F, 0x00, 0x00, 0x00, 0x00, 0x00, 0x00, 0x00, 0x00,
0x00, 0x00, 0x00, 0x00, 0x00, 0x00, 0x00, 0x00, 0x1F, 0xFC, 0xF0, 0xF8, 0x1E, 0x1F, 0x00, 0x00,
0x00, 0x00, 0x00, 0x00, 0x00, 0x00, 0x00, 0x00, 0x00, 0xE0, 0xE0, 0xE0, 0xE0, 0x20, 0x20, 0x20,
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0x00, 0x00, 0x00, 0x00, 0x00, 0x00, 0x00, 0x00, 0x00, 0x00, 0x00, 0x00, 0x00, 0x00, 0x00, 0x00
};

static unsigned char  Realtek_LogoR[] PROGMEM ={
0x00, 0x00, 0x3F, 0x3F, 0xFF, 0xFC, 0xFC, 0xFF, 0x3F, 0x3F, 0x00, 0x00, 0x00, 0x80, 0x80, 0x80,
0x00, 0x00, 0x00, 0x80, 0x80, 0x00, 0x00, 0x00, 0x3F, 0x3F, 0xFF, 0xFC, 0xF8, 0xFF, 0x3F, 0x3F,
0x00, 0x00, 0x00, 0x00, 0x00, 0x00, 0x00, 0x00, 0x00, 0x00, 0xE0, 0xE0, 0xE0, 0xE0, 0xE0, 0x60,
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0x00, 0x00, 0x00, 0x00, 0x00, 0x00, 0x00, 0x00, 0x00, 0x00, 0x00, 0x00, 0x00, 0x00, 0x00, 0x00
};

void setup() {
  Serial.begin(9600);
  Wire.begin();	

  SeeedOled.init();  //initialze SEEED OLED display
  SeeedOled.clearDisplay();           //clear the screen and set start position to top left corner
  SeeedOled.drawBitmap( realtek_ch,1024); 
  delay (3000);
  
  memset(logRT, 0, 1024);
  memcpy(logRT,realtek_ch,384);
  //memset(realtek_ch, 0, 1024);
  //SeeedOled.drawBitmap( realtek_ch,1024);  
  //SeeedOled.drawBitmap( logRT,384); 
  //SeeedOled.setNormalDisplay();       //Set display to Normal mode
  //SeeedOled.setPageMode();            //Set addressing mode to Page Mode
  //SeeedOled.setHorizontalScrollProperties(Scroll_Left,0,7,Scroll_5Frames); //Set Scrolling properties to Scroll Right
  //SeeedOled.activateScroll();             // Activate Scrolling  
  dht.begin();
  delay (1000);
}

int numloop=0;
void loop() {
  if (numloop == 0 ){
    numloop += 1;
    SeeedOled.clearDisplay(); 
    SeeedOled.drawBitmap(logRT,384); 
    //SeeedOled.setHorizontalScrollProperties(Scroll_Left,0,2,Scroll_5Frames); //Set Scrolling properties to Scroll Right
    //SeeedOled.activateScroll();             // Activate Scrolling 
  }

  //Temperature
  float t = dht.readTemperature();
  SeeedOled.setTextXY(4,0);
  SeeedOled.putString("Temp:");
  SeeedOled.putNumber(t);
  SeeedOled.putString("C  "); 

  //Humidity
  float h = dht.readHumidity();
  SeeedOled.setTextXY(5,0);
  SeeedOled.putString("Humi:");
  SeeedOled.putNumber(h);
  SeeedOled.putString("%  ");  

  //PM
  int idx = 0, count = 0;
  Serial1.begin(9600);
  while (true) {
    while (c != 0x42) {
      SeeedOled.setTextXY(6,0);
      SeeedOled.putNumber(c);
      SeeedOled.putString(" ");
      SeeedOled.putNumber(count++);
      while (!Serial1.available());
      c = Serial1.read();
    }
    while (!Serial1.available());
    c = Serial1.read();
    if (c == 0x4d) {
      // now we got a correct header)
      buf[idx++] = 0x42;
      buf[idx++] = 0x4d;
      break;
    }
  }

  while (idx != DATA_LEN) {
    while(!Serial1.available());
    buf[idx++] = Serial1.read();
    //delay(20);
  }
  Serial1.end();

  //PM 1
  int pm1 = ( buf[10] << 8 ) | buf[11];
  SeeedOled.setTextXY(6,0);
  SeeedOled.putString("PM1.0:");
  SeeedOled.putNumber(pm1);
  SeeedOled.putString("ug/m3");  

  //PM 2.5
  int pm2_5 = ( buf[12] << 8 ) | buf[13];
  SeeedOled.setTextXY(7,0);
  SeeedOled.putString("PM2.5:");
  SeeedOled.putNumber(pm2_5);
  SeeedOled.putString("ug/m3");  
  
  //int pm100 = ( buf[14] << 8 ) | buf[15];

  delay(1000);
  
}
